/* Script for -z combreloc: combine and sort reloc sections */
/* Copyright (C) 2014-2017 Free Software Foundation, Inc.
   Copying and distribution of this script, with or without modification,
   are permitted in any medium without royalty provided the copyright
   notice and this notice are preserved.  */
OUTPUT_FORMAT("elf32-powerpc", "elf32-powerpc",
              "elf32-powerpc")
OUTPUT_ARCH(powerpc:common)
ENTRY(_start)

MEMORY {
  /* RAM begins at 0, but we leave lower 64MB
   * free for QEMU to load guest image
   */
  ram (rwx) : ORIGIN = 0x4000000, LENGTH = 64K
  rom (rx) : ORIGIN = 0xff800000, LENGTH = 8M - 4K
  /* as per the mpc8540 ref. manual, assume that after reset the TLB
   * only maps the last 4kb and place early setup code here.
   */
  early (rx) : ORIGIN = 0xfffff000, LENGTH = 4K - 4
  /* reset vector */
  reset (rx) : ORIGIN = 0xfffffffc, LENGTH = 4
}

SECTIONS
{
  .text           :
  {
    PROVIDE(__text_start = .);
    *(.text.start) /* ensure that _start() appears first */
    *(.text.unlikely .text.*_unlikely .text.unlikely.*)
    *(.text.exit .text.exit.*)
    *(.text.startup .text.startup.*)
    *(.text.hot .text.hot.*)
    *(.text .stub .gnu.linkonce.t.*)
    /* .gnu.warning sections are handled specially by elf32.em.  */
    *(.gnu.warning)
    *(.glink)
  } >rom
  .interp         : { *(.interp) }
   >rom
  .note.gnu.build-id : { *(.note.gnu.build-id) }
   >rom
  .hash           : { *(.hash) }
   >rom
  .gnu.hash       : { *(.gnu.hash) }
   >rom
  .dynsym         : { *(.dynsym) }
   >rom
  .dynstr         : { *(.dynstr) }
   >rom
  .gnu.version    : { *(.gnu.version) }
   >rom
  .gnu.version_d  : { *(.gnu.version_d) }
   >rom
  .gnu.version_r  : { *(.gnu.version_r) }
   >rom
  .rela.dyn       :
    {
      *(.rela.init)
      *(.rela.text .rela.text.* .rela.gnu.linkonce.t.*)
      *(.rela.fini)
      *(.rela.rodata .rela.rodata.* .rela.gnu.linkonce.r.*)
      *(.rela.data .rela.data.* .rela.gnu.linkonce.d.*)
      *(.rela.tdata .rela.tdata.* .rela.gnu.linkonce.td.*)
      *(.rela.tbss .rela.tbss.* .rela.gnu.linkonce.tb.*)
      *(.rela.ctors)
      *(.rela.dtors)
      *(.rela.got)
      *(.rela.got1)
      *(.rela.got2)
      *(.rela.sdata .rela.sdata.* .rela.gnu.linkonce.s.*)
      *(.rela.sbss .rela.sbss.* .rela.gnu.linkonce.sb.*)
      *(.rela.sdata2 .rela.sdata2.* .rela.gnu.linkonce.s2.*)
      *(.rela.sbss2 .rela.sbss2.* .rela.gnu.linkonce.sb2.*)
      *(.rela.bss .rela.bss.* .rela.gnu.linkonce.b.*)
      PROVIDE_HIDDEN (__rela_iplt_start = .);
      *(.rela.iplt)
      PROVIDE_HIDDEN (__rela_iplt_end = .);
    } > rom
  .rela.plt       :
    {
      *(.rela.plt)
    } > rom
  .init           :
  {
    KEEP (*(SORT_NONE(.init)))
  } >rom
  .fini           :
  {
    KEEP (*(SORT_NONE(.fini)))
    PROVIDE (__text_end = .);
  } >rom
  .rodata         : {
    PROVIDE (__rodata_start = .);
    *(.rodata .rodata.* .gnu.linkonce.r.*) 
  } >rom
  .rodata1        : {
    *(.rodata1)
    PROVIDE (__rodata_end = .);
  } >rom
  .sdata2         :
  {
    PROVIDE (__sdata2_start = .);
    *(.sdata2 .sdata2.* .gnu.linkonce.s2.*)
    PROVIDE (__sdata2_end = .);
  } >ram AT>rom
  PROVIDE (__sdata2_load = LOADADDR(.sdata2));
  .sbss2          : {
    PROVIDE (__sbss2_start = .);
    *(.sbss2 .sbss2.* .gnu.linkonce.sb2.*)
    PROVIDE (__sbss2_end = .);
  } >ram AT>rom
  .eh_frame_hdr : {
    PROVIDE (__data_start = .);
    *(.eh_frame_hdr) *(.eh_frame_entry .eh_frame_entry.*)
  } >ram AT>rom
  .eh_frame       : ONLY_IF_RO { KEEP (*(.eh_frame)) *(.eh_frame.*) }
  >ram AT>rom
  .gcc_except_table   : ONLY_IF_RO { *(.gcc_except_table
  .gcc_except_table.*) }
  >ram AT>rom
  .gnu_extab   : ONLY_IF_RO { *(.gnu_extab*) }
  >ram AT>rom
  /* These sections are generated by the Sun/Oracle C++ compiler.  */
  .exception_ranges   : ONLY_IF_RO { *(.exception_ranges
  .exception_ranges*) }
  >ram AT>rom
  /* Adjust the address for the data segment.  We want to adjust up to
     the same address within the page on the next page up.  */
  . = DATA_SEGMENT_ALIGN (CONSTANT (MAXPAGESIZE), CONSTANT (COMMONPAGESIZE));
  /* Exception handling  */
  .eh_frame       : ONLY_IF_RW { KEEP (*(.eh_frame)) *(.eh_frame.*) }
  >ram AT>rom
  .gnu_extab      : ONLY_IF_RW { *(.gnu_extab) }
  >ram AT>rom
  .gcc_except_table   : ONLY_IF_RW { *(.gcc_except_table .gcc_except_table.*) }
  >ram AT>rom
  .exception_ranges   : ONLY_IF_RW { *(.exception_ranges .exception_ranges*) }
  >ram AT>rom
  /* Thread Local Storage sections  */
  .tdata          : { *(.tdata .tdata.* .gnu.linkonce.td.*) }
  >ram AT>rom
  .tbss           : { *(.tbss .tbss.* .gnu.linkonce.tb.*) *(.tcommon) }
  >ram AT>rom
  .preinit_array     :
  {
    PROVIDE_HIDDEN (__preinit_array_start = .);
    KEEP (*(.preinit_array))
    PROVIDE_HIDDEN (__preinit_array_end = .);
  } >ram AT>rom
  .init_array     :
  {
    PROVIDE_HIDDEN (__init_array_start = .);
    KEEP (*(SORT_BY_INIT_PRIORITY(.init_array.*) SORT_BY_INIT_PRIORITY(.ctors.*)))
    KEEP (*(.init_array EXCLUDE_FILE (*crtbegin.o *crtbegin?.o *crtend.o *crtend?.o ) .ctors))
    PROVIDE_HIDDEN (__init_array_end = .);
  } >ram AT>rom
  .fini_array     :
  {
    PROVIDE_HIDDEN (__fini_array_start = .);
    KEEP (*(SORT_BY_INIT_PRIORITY(.fini_array.*) SORT_BY_INIT_PRIORITY(.dtors.*)))
    KEEP (*(.fini_array EXCLUDE_FILE (*crtbegin.o *crtbegin?.o *crtend.o *crtend?.o ) .dtors))
    PROVIDE_HIDDEN (__fini_array_end = .);
  } >ram AT>rom
  .ctors          :
  {
    /* gcc uses crtbegin.o to find the start of
       the constructors, so we make sure it is
       first.  Because this is a wildcard, it
       doesn't matter if the user does not
       actually link against crtbegin.o; the
       linker won't look for a file to match a
       wildcard.  The wildcard also means that it
       doesn't matter which directory crtbegin.o
       is in.  */
    KEEP (*crtbegin.o(.ctors))
    KEEP (*crtbegin?.o(.ctors))
    /* We don't want to include the .ctor section from
       the crtend.o file until after the sorted ctors.
       The .ctor section from the crtend file contains the
       end of ctors marker and it must be last */
    KEEP (*(EXCLUDE_FILE (*crtend.o *crtend?.o ) .ctors))
    KEEP (*(SORT(.ctors.*)))
    KEEP (*(.ctors))
  } >ram AT>rom
  .dtors          :
  {
    KEEP (*crtbegin.o(.dtors))
    KEEP (*crtbegin?.o(.dtors))
    KEEP (*(EXCLUDE_FILE (*crtend.o *crtend?.o ) .dtors))
    KEEP (*(SORT(.dtors.*)))
    KEEP (*(.dtors))
  } >ram AT>rom
  .jcr            : { KEEP (*(.jcr)) }
  >ram AT>rom
  .data.rel.ro : { *(.data.rel.ro.local* .gnu.linkonce.d.rel.ro.local.*) *(.data.rel.ro .data.rel.ro.* .gnu.linkonce.d.rel.ro.*) }
  >ram AT>rom
  .got1           : { *(.got1) }
  >ram AT>rom
  .got2           : { *(.got2) }
  >ram AT>rom
  .dynamic        : { *(.dynamic) }
  >ram AT>rom
  .got            : SPECIAL { *(.got) }
  >ram AT>rom
  . = DATA_SEGMENT_RELRO_END (0, .);
  .plt            : SPECIAL { *(.plt) }
  >ram AT>rom
  .data           :
  {
    *(.data .data.* .gnu.linkonce.d.*)
    SORT(CONSTRUCTORS)
  }
  >ram AT>rom
  .data1          : { *(.data1) }
  >ram AT>rom
  .got            : SPECIAL {
    *(.got)
    PROVIDE (__data_end = .);
  } >ram AT>rom
  PROVIDE (__data_load = LOADADDR(.eh_frame_hdr));
  /* We want the small data sections together, so single-instruction offsets
     can access them all, and initialized data all before uninitialized, so
     we can shorten the on-disk segment size.  */
  .sdata          :
  {
    PROVIDE (__sdata_start = .);
    *(.sdata .sdata.* .gnu.linkonce.s.*)
    PROVIDE (__sdata_end = .);
  } >ram AT>rom
  PROVIDE (__sdata_load = LOADADDR(.sdata));

  .sbss           :
  {
    PROVIDE (__sbss_start = .); PROVIDE (___sbss_start = .);
    *(.dynsbss)
    *(.sbss .sbss.* .gnu.linkonce.sb.*)
    *(.scommon)
    PROVIDE (__sbss_end = .); PROVIDE (___sbss_end = .);
  } >ram AT>rom
  .plt            : SPECIAL {
    PROVIDE (__bss_start = .);
    *(.plt)
  }
  >ram AT>rom
  .iplt           : { *(.iplt) }
  >ram AT>rom
  .bss            :
  {
   *(.dynbss)
   *(.bss .bss.* .gnu.linkonce.b.*)
   *(COMMON)
   PROVIDE (__bss_end = .);
   /* don't zero stack, this allows initialization from C code */
   *(.stack)
  } >ram AT>rom
  
  .text.early : {*(.text.early)} >early
  .text.reset : {*(.text.init)} >reset

  . = DATA_SEGMENT_END (.);
  /* Stabs debugging sections.  */
  .stab          0 : { *(.stab) }
  .stabstr       0 : { *(.stabstr) }
  .stab.excl     0 : { *(.stab.excl) }
  .stab.exclstr  0 : { *(.stab.exclstr) }
  .stab.index    0 : { *(.stab.index) }
  .stab.indexstr 0 : { *(.stab.indexstr) }
  .comment       0 : { *(.comment) }
  /* DWARF debug sections.
     Symbols in the DWARF debugging sections are relative to the beginning
     of the section so we begin them at 0.  */
  /* DWARF 1 */
  .debug          0 : { *(.debug) }
  .line           0 : { *(.line) }
  /* GNU DWARF 1 extensions */
  .debug_srcinfo  0 : { *(.debug_srcinfo) }
  .debug_sfnames  0 : { *(.debug_sfnames) }
  /* DWARF 1.1 and DWARF 2 */
  .debug_aranges  0 : { *(.debug_aranges) }
  .debug_pubnames 0 : { *(.debug_pubnames) }
  /* DWARF 2 */
  .debug_info     0 : { *(.debug_info .gnu.linkonce.wi.*) }
  .debug_abbrev   0 : { *(.debug_abbrev) }
  .debug_line     0 : { *(.debug_line .debug_line.* .debug_line_end ) }
  .debug_frame    0 : { *(.debug_frame) }
  .debug_str      0 : { *(.debug_str) }
  .debug_loc      0 : { *(.debug_loc) }
  .debug_macinfo  0 : { *(.debug_macinfo) }
  /* SGI/MIPS DWARF 2 extensions */
  .debug_weaknames 0 : { *(.debug_weaknames) }
  .debug_funcnames 0 : { *(.debug_funcnames) }
  .debug_typenames 0 : { *(.debug_typenames) }
  .debug_varnames  0 : { *(.debug_varnames) }
  /* DWARF 3 */
  .debug_pubtypes 0 : { *(.debug_pubtypes) }
  .debug_ranges   0 : { *(.debug_ranges) }
  /* DWARF Extension.  */
  .debug_macro    0 : { *(.debug_macro) }
  .debug_addr     0 : { *(.debug_addr) }
  .gnu.attributes 0 : { KEEP (*(.gnu.attributes)) }
  /DISCARD/     : { *(.fixup) }
  /DISCARD/ : { *(.note.GNU-stack) *(.gnu_debuglink) *(.gnu.lto_*) }
  /DISCARD/ : { *(.PPC.EMB.apuinfo) }
}
